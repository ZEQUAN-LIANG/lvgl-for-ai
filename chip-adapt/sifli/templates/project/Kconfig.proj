## chip-adapt/sifli/templates/project/Kconfig.proj
```kconfig
config CUSTOM_MEM_MAP
    bool
    select custom_mem_map
    default y if !SOC_SIMULATOR

menu "app cache Memory configuration"

choice
    prompt "rotation image preferred cache memory"
    default ROTATE_MEM_IN_PSRAM
    config ROTATE_MEM_IN_PSRAM
        depends on BSP_USING_PSRAM
        bool "PSRAM"
    config ROTATE_MEM_IN_SRAM
        bool "SRAM"
endchoice

config IMAGE_CACHE_IN_PSRAM_SIZE
    int "image cache in psram size(standalone)"
    depends on BSP_USING_PSRAM
    default 2100000

config IMAGE_CACHE_IN_PSRAM_SIZE
    int
    depends on !BSP_USING_PSRAM
    default 0

config IMAGE_CACHE_IN_SRAM_SIZE
    int "image cache in sram size(standalone)"
    default 200000

endmenu
```
